## templates/nuttx-app-template/Kconfig
```kconfig
config EXAMPLES_ECL_HELLO
    bool "Embedded Code Library hello application"
    default n
    ---help---
        Minimal application skeleton. Verify menu location and dependencies
        against the target NuttX Apps version before use.
```
